## conf/layer.conf
```bitbake
##########################################################################
# ============================================================================
# RDK MANAGEMENT, LLC CONFIDENTIAL AND PROPRIETARY
# ============================================================================
# This file (and its contents) are the intellectual property of RDK Management, LLC.
# It may not be used, copied, distributed or otherwise disclosed in whole or in
# part without the express written permission of RDK Management, LLC.
# ============================================================================
# Copyright (c) 2018 RDK Management, LLC. All rights reserved.
# ============================================================================
##########################################################################
BBPATH .= ":${LAYERDIR}"
BBFILES += "\
            ${LAYERDIR}/recipes-*/*/*.bb \
            ${LAYERDIR}/recipes-*/*/*.bbappend \
           "

BBFILE_COLLECTIONS += "gl-motion-detection"
BBFILE_PATTERN_gl-motion-detection := "^${LAYERDIR}/"
BBFILE_PRIORITY_gl-motion-detection = "30"

# do not error out on bbappends for missing recipes (mysql5)
#BB_DANGLINGAPPENDS_WARNONLY = "true"

# Additional license directories.
LICENSE_PATH += "${LAYERDIR}/licenses"

GCCVERSION_daisy ?= "4.9%"
```
